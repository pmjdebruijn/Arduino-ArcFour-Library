/*
  ArcFour Test Vectors
  
  created 10 Jun 2014
  by Pascal de Bruijn
  
 */

#include <ArcFour.h>

ArcFour ArcFour;

int ledPin = 13;

byte vectorF[3][8] = {{ 0x01, 0x23, 0x45, 0x67, 0x89, 0xab, 0xcd, 0xef },
                      { 0x01, 0x23, 0x45, 0x67, 0x89, 0xab, 0xcd, 0xef },
                      { 0x74, 0xb6, 0x86, 0x81, 0x98, 0xe1, 0xc6, 0x95 }};

byte vector0[3][8] = {{ 0x01, 0x23, 0x45, 0x67, 0x89, 0xab, 0xcd, 0xef },
                      { 0x01, 0x23, 0x45, 0x67, 0x89, 0xab, 0xcd, 0xef },
                      { 0x75, 0xb7, 0x87, 0x80, 0x99, 0xe0, 0xc5, 0x96 }};

byte vector1[3][8] = {{ 0x01, 0x23, 0x45, 0x67, 0x89, 0xab, 0xcd, 0xef },
                      { 0x00, 0x00, 0x00, 0x00, 0x00, 0x00, 0x00, 0x00 },
                      { 0x74, 0x94, 0xc2, 0xe7, 0x10, 0x4b, 0x08, 0x79 }};

byte vector2[3][8] = {{ 0x00, 0x00, 0x00, 0x00, 0x00, 0x00, 0x00, 0x00 },
                      { 0x00, 0x00, 0x00, 0x00, 0x00, 0x00, 0x00, 0x00 },
                      { 0xde, 0x18, 0x89, 0x41, 0xa3, 0x37, 0x5d, 0x3a }};

boolean testVector(byte vector[3][8])
{
  int good = 0;
  int fail = 0;
  
  ArcFour.initialize();
  
  for (int i = 0; i < ARCFOUR_MAX; i++)
  {
    ArcFour.seed(i, vector[0][i % sizeof(vector0[0])]);
  }
  
  ArcFour.finalize();
  
  for (int i = 0; i < sizeof(vector[0]); i++)
  {
    if ((vector[1][i] ^ ArcFour.random()) == vector[2][i])
      good++;
    else
      fail++;
  }
  
  return ((good == 8) && (fail == 0));
}

void setup()
{
  if (!testVector(vectorF) && testVector(vector0) && testVector(vector1) && testVector(vector2))
  {
    digitalWrite(ledPin, HIGH);
  }
}

void loop()
{
}

